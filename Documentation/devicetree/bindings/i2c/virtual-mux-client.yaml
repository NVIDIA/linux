## Documentation/devicetree/bindings/i2c/virtual-mux-client.yaml
```yaml
# SPDX-License-Identifier: (GPL-2.0-only OR BSD-2-Clause)
%YAML 1.2
---
$id: http://devicetree.org/schemas/i2c/virtual-mux-client.yaml#
$schema: http://devicetree.org/meta-schemas/core.yaml#

title: Virtual I2C Mux Client (Remote I2C FRU Bridge Target)

maintainers:
  - Radivoje (Ogi) Jovanovic <rjovanovic@nvidia.com>

description: |
  The virtual-mux-client is an I2C target/slave on a link bus. It receives
  framed I2C requests from a virtual-mux-host and executes them on a mapped
  downstream I2C adapter. Downstream address and bus mappings are provided
  by child nodes.

properties:
  compatible:
    const: virtual-mux-client

  reg:
    maxItems: 1
    description: I2C address of the target on the link bus.

  use-crc16:
    type: boolean
    description:
      Enable CRC16 framing for requests and responses.

patternProperties:
  "^map@[0-9a-f]+$":
    type: object
    description: |
      Mapping from a virtual I2C address to a downstream bus and address.
    properties:
      reg:
        description: Virtual I2C address (7-bit).
        maxItems: 1
      downstream-bus:
        $ref: /schemas/types.yaml#/definitions/uint32
        description: Downstream I2C bus number to execute transfers on.
      downstream-addr:
        $ref: /schemas/types.yaml#/definitions/uint32
        description: Downstream 7-bit I2C address.
    required:
      - reg
      - downstream-bus
      - downstream-addr
    additionalProperties: false

required:
  - compatible
  - reg

additionalProperties: false

examples:
  - |
    i2c@0 {
        #address-cells = <1>;
        #size-cells = <0>;

        bridge@52 {
            compatible = "virtual-mux-client";
            reg = <0x52>;
            use-crc16;

            map@50 {
                reg = <0x50>;
                downstream-bus = <3>;
                downstream-addr = <0x50>;
            };
        };
    };
```

## Documentation/devicetree/bindings/i2c/virtual-mux-host.yaml
```yaml
# SPDX-License-Identifier: (GPL-2.0-only OR BSD-2-Clause)
%YAML 1.2
---
$id: http://devicetree.org/schemas/i2c/virtual-mux-host.yaml#
$schema: http://devicetree.org/meta-schemas/core.yaml#

title: Virtual I2C Mux Host (Remote I2C FRU Host Adapter)

maintainers:
  - Radivoje (Ogi) Jovanovic <rjovanovic@nvidia.com>

description: |
  The virtual-mux-host is an I2C client on a link bus that exposes a virtual
  I2C adapter to Linux. Transfers submitted to the virtual adapter are framed
  and forwarded over the link bus to a remote bridge target.

properties:
  compatible:
    const: virtual-mux-host

  reg:
    maxItems: 1
    description: I2C address of the remote bridge target on the link bus.

  use-crc16:
    type: boolean
    description:
      Enable CRC16 framing for requests and responses.

  virtual-bus-num:
    $ref: /schemas/types.yaml#/definitions/uint32
    description:
      Optional fixed bus number for the virtual adapter.

required:
  - compatible
  - reg

additionalProperties: false

examples:
  - |
    i2c@0 {
        #address-cells = <1>;
        #size-cells = <0>;

        bridge@52 {
            compatible = "virtual-mux-host";
            reg = <0x52>;
            use-crc16;
            virtual-bus-num = <12>;
        };
    };
```

## Documentation/devicetree/bindings/ipmi/ssif-bmc.yaml
```yaml
# SPDX-License-Identifier: (GPL-2.0-only OR BSD-2-Clause)
%YAML 1.2
---
$id: http://devicetree.org/schemas/ipmi/ssif-bmc.yaml#
$schema: http://devicetree.org/meta-schemas/core.yaml#

title: SSIF IPMI BMC interface

description: SSIF IPMI BMC device bindings

maintainers:
  - Quan Nguyen <quan@os.amperecomputing.com>

properties:
  compatible:
    enum:
      - ssif-bmc

  reg:
    maxItems: 1

  bus-nack:
    type: boolean
    description:
      The bus controller refuses a host read when the slave callback
      returns an error (see the controller binding). The driver then
      returns -EPROTO for a read with no response staged instead of
      hiding its slave address.

required:
  - compatible
  - reg

additionalProperties: false

examples:
  - |
    i2c {
        #address-cells = <1>;
        #size-cells = <0>;

        ssif-bmc@10 {
            compatible = "ssif-bmc";
            reg = <0x10>;
        };
    };
```

## Documentation/devicetree/bindings/net/nvidia,ast27xx-irot.yaml
```yaml
# SPDX-License-Identifier: (GPL-2.0-only OR BSD-2-Clause)
%YAML 1.2
---
$id: http://devicetree.org/schemas/net/nvidia,ast27xx-irot.yaml#
$schema: http://devicetree.org/meta-schemas/core.yaml#

title: NVIDIA IRoT MCTP interface for ASPEED AST27xx BMCs

maintainers:
  - afickle@nvidia.com

description: |
  The NVIDIA IRoT MCTP interface uses the ASPEED AST2700 mailbox controller
  for IPC notifications and firmware-provided shared memory for packet data.
  The driver registers an MCTP netdev so the kernel MCTP stack can route
  packets to the IRoT firmware.

properties:
  compatible:
    const: nvidia,ast27xx,irot

  mboxes:
    maxItems: 1
    description: Mailbox channel used for IRoT IPC notifications.

  mbox-names:
    items:
      - const: irot

required:
  - compatible
  - mboxes
  - mbox-names

additionalProperties: false

examples:
  - |
    mctp-irot {
        compatible = "nvidia,ast27xx,irot";
        mboxes = <&mbox0 0>;
        mbox-names = "irot";
    };
```

## Documentation/devicetree/bindings/usb/nvidia,lstp-gpio.yaml
```yaml
# SPDX-License-Identifier: (GPL-2.0-only OR BSD-2-Clause)
%YAML 1.2
---
$schema: http://devicetree.org/meta-schemas/core.yaml#

title: NVIDIA LSTP GPIO Channel

description: |
  GPIO controller channel on an NVIDIA LSTP USB device.

  The LSTP GPIO channel registers as a Linux GPIO chip.  The number of
  GPIO lines and their firmware-default names/directions are reported by
  the device firmware at probe time.

  DT properties such as gpio-line-names override the firmware-reported
  pin names.  The gpio-controller and #gpio-cells properties enable
  phandle references from consumers (e.g. gpio-leds, gpio-keys).

  GPIO hog child nodes are supported for boot-time pin configuration.

  Note: because the GPIO controller sits behind USB, all operations are
  inherently sleeping (can_sleep = true).  Consumers that require
  non-sleeping GPIO access cannot use this controller.

properties:
  compatible:
    const: nvidia,lstp-gpio

  reg:
    description: LSTP channel ID as reported by firmware.
    maxItems: 1

  gpio-controller: true

  "#gpio-cells":
    const: 2
    description: |
      Two cells: pin number and flags.
      Cell 0: GPIO pin offset (0-based).
      Cell 1: GPIO flags (e.g. GPIO_ACTIVE_LOW).

  gpio-line-names:
    description: |
      Optional list of human-readable names for each GPIO line.
      Overrides the firmware-reported pin names.  The number of entries
      must not exceed the number of GPIO lines reported by firmware.
    minItems: 1
    maxItems: 255

  ngpios:
    description: |
      Override the number of GPIO lines.  Normally the pin count is
      determined by firmware; this property is only needed if the DT
      must constrain it further.
    minimum: 1
    maximum: 255

patternProperties:
  "^.+-hog(-[0-9]+)?$":
    type: object
    required:
      - gpio-hog
      - gpios

    properties:
      gpio-hog: true
      gpios:
        description: Pin offset and flags for the hog.
      output-high: true
      output-low: true
      input: true
      line-name:
        description: Consumer name shown in /sys/kernel/debug/gpio.

    additionalProperties: false

required:
  - compatible
  - reg
  - gpio-controller
  - "#gpio-cells"

additionalProperties: false

examples:
  - |
    /* Minimal: let firmware define pin count and names */
    channel@3 {
        compatible = "nvidia,lstp-gpio";
        reg = <3>;
        gpio-controller;
        #gpio-cells = <2>;
    };
  - |
    /* Override pin names and add a hog */
    gpio_ch: channel@3 {
        compatible = "nvidia,lstp-gpio";
        reg = <3>;
        gpio-controller;
        #gpio-cells = <2>;
        gpio-line-names = "STATUS_LED", "ALERT_INT";

        led-hog {
            gpio-hog;
            gpios = <0 0>;
            output-high;
            line-name = "status-led-hog";
        };
    };
```

## Documentation/devicetree/bindings/usb/nvidia,lstp-i2c.yaml
```yaml
# SPDX-License-Identifier: (GPL-2.0-only OR BSD-2-Clause)
%YAML 1.2
---
$schema: http://devicetree.org/meta-schemas/core.yaml#

title: NVIDIA LSTP I2C Channel

description: |
  I2C bus master channel on an NVIDIA LSTP USB device.

  The LSTP I2C channel registers as a Linux I2C adapter.  Child nodes
  describe I2C peripherals on the bus and are auto-enumerated by the
  I2C core at probe time.

  Bus numbering is controlled via standard DT aliases (e.g.
  i2c20 = &channel_label).  Without an alias the I2C core assigns a
  dynamic bus number.

properties:
  compatible:
    const: nvidia,lstp-i2c

  reg:
    description: LSTP channel ID as reported by firmware.
    maxItems: 1

  "#address-cells":
    const: 1

  "#size-cells":
    const: 0

  clock-frequency:
    description: |
      I2C bus clock frequency in Hz.  Reserved for future use.
      Common values: 100000 (standard), 400000 (fast).
    default: 100000

patternProperties:
  "^[a-zA-Z][a-zA-Z0-9,-]*@[0-9a-f]+$":
    type: object
    additionalProperties: true

    properties:
      compatible:
        description: Compatible string for the I2C peripheral.

      reg:
        description: I2C slave address.
        maxItems: 1

    required:
      - compatible
      - reg

required:
  - compatible
  - reg

additionalProperties: false

examples:
  - |
    /* Minimal: dynamic bus number, one child device */
    channel@2 {
        compatible = "nvidia,lstp-i2c";
        reg = <2>;
        #address-cells = <1>;
        #size-cells = <0>;

        sensor@48 {
            compatible = "ti,tmp102";
            reg = <0x48>;
        };
    };
```

## Documentation/devicetree/bindings/usb/nvidia,lstp-ipmi.yaml
```yaml
# SPDX-License-Identifier: (GPL-2.0-only OR BSD-2-Clause)
%YAML 1.2
---
$schema: http://devicetree.org/meta-schemas/core.yaml#

title: NVIDIA LSTP IPMI Channel

description: |
  IPMI message channel on an NVIDIA LSTP USB device.

  The LSTP IPMI channel registers as a miscdevice (/dev/<label>).  It
  provides a character device interface for sending and receiving raw
  IPMI messages to/from the LSTP microcontroller.

  The device name defaults to "ipmi-lstpN" (where N is an auto-allocated
  ID).  The "label" property overrides this with a stable, predictable
  name — recommended for systems with multiple LSTP devices.

properties:
  compatible:
    const: nvidia,lstp-ipmi

  reg:
    description: LSTP channel ID as reported by firmware.
    maxItems: 1

  label:
    description: |
      Stable device name for the miscdevice (e.g. "ipmi-lstp-mcu").
      Creates /dev/<label>.  If omitted, the driver auto-generates
      "ipmi-lstpN" where N is a monotonically increasing ID.

required:
  - compatible
  - reg

additionalProperties: false

examples:
  - |
    /* With explicit label */
    channel@4 {
        compatible = "nvidia,lstp-ipmi";
        reg = <4>;
        label = "ipmi-lstp-mcu";
    };
  - |
    /* Without label — driver auto-names as ipmi-lstp0 */
    channel@4 {
        compatible = "nvidia,lstp-ipmi";
        reg = <4>;
    };
```

## Documentation/devicetree/bindings/usb/nvidia,lstp-spi.yaml
```yaml
# SPDX-License-Identifier: (GPL-2.0-only OR BSD-2-Clause)
%YAML 1.2
---
$schema: http://devicetree.org/meta-schemas/core.yaml#

title: NVIDIA LSTP SPI Channel

description: |
  SPI bus master channel on an NVIDIA LSTP USB device.

  The LSTP SPI channel registers as a Linux SPI controller.  Child nodes
  describe SPI peripherals attached to each chip-select.  When a DT node
  is present, the SPI core auto-enumerates children; otherwise the driver
  falls back to board_info registration.

  The number of chip selects and bus speed are reported by the device
  firmware.  Up to 2 chip selects (CS0-CS1) are supported by the driver.

allOf:
  - $ref: /schemas/spi/spi-controller.yaml#

properties:
  compatible:
    const: nvidia,lstp-spi

  reg:
    description: LSTP channel ID as reported by firmware.
    maxItems: 1

  "#address-cells":
    const: 1

  "#size-cells":
    const: 0

patternProperties:
  "^[a-zA-Z][a-zA-Z0-9,-]*@[0-9a-f]+$":
    type: object
    additionalProperties: true

    properties:
      compatible:
        description: Compatible string for the SPI peripheral device.

      reg:
        description: Chip-select number (0-1).
        minimum: 0
        maximum: 1

      spi-max-frequency:
        description: |
          Maximum SPI clock frequency in Hz.  Must not exceed the speed
          reported by the LSTP device firmware.

    required:
      - compatible
      - reg

required:
  - compatible
  - reg
  - "#address-cells"
  - "#size-cells"

unevaluatedProperties: false

examples:
  - |
    channel@1 {
        compatible = "nvidia,lstp-spi";
        reg = <1>;
        #address-cells = <1>;
        #size-cells = <0>;

        spidev@0 {
            compatible = "nvidia,lstp-spidev";
            reg = <0>;
            spi-max-frequency = <24000000>;
        };

        spidev@1 {
            compatible = "nvidia,lstp-spidev";
            reg = <1>;
            spi-max-frequency = <24000000>;
        };
    };
```

## Documentation/devicetree/bindings/usb/nvidia,lstp-uart.yaml
```yaml
# SPDX-License-Identifier: (GPL-2.0-only OR BSD-2-Clause)
%YAML 1.2
---
$schema: http://devicetree.org/meta-schemas/core.yaml#

title: NVIDIA LSTP UART Channel

description: |
  UART channel on an NVIDIA LSTP USB device.

  The LSTP UART channel registers as a Linux tty device (/dev/ttyLSTPN,
  where N is a dynamically allocated minor).  Baud rate, framing, parity,
  and flow-control settings are reported by the device firmware at probe
  time and cannot be changed at runtime — userspace termios hardware bits
  are silently preserved across stty(1) invocations.

  A DT node is optional.  When present, it is attached to the tty device
  so that udev rules can produce stable /dev/serial/by-* symlinks and so
  that serdev-attached child devices (Bluetooth, GNSS, NFC, etc.) can be
  enumerated as DT children.

properties:
  compatible:
    const: nvidia,lstp-uart

  reg:
    description: LSTP channel ID as reported by firmware.
    maxItems: 1

patternProperties:
  "^[a-zA-Z][a-zA-Z0-9,-]*$":
    type: object
    description: |
      Optional serdev child device attached to this UART (e.g. Bluetooth
      HCI, GNSS module).  Enumerated by the serdev core when the tty is
      opened.
    additionalProperties: true

    properties:
      compatible:
        description: Compatible string for the serdev peripheral.

    required:
      - compatible

required:
  - compatible
  - reg

additionalProperties: false

examples:
  - |
    /* Bare UART exposed as /dev/ttyLSTPN */
    channel@5 {
        compatible = "nvidia,lstp-uart";
        reg = <5>;
    };
  - |
    /* UART with an attached serdev child */
    channel@5 {
        compatible = "nvidia,lstp-uart";
        reg = <5>;

        bluetooth {
            compatible = "brcm,bcm43438-bt";
            max-speed = <3000000>;
        };
    };
```

## drivers/net/phy/realtek/Kconfig
```kconfig
# SPDX-License-Identifier: GPL-2.0-only
config REALTEK_PHY
	tristate "Realtek PHYs"
	help
	  Currently supports RTL821x/RTL822x and fast ethernet PHYs

if REALTEK_PHY

config REALTEK_PHY_HWMON
	bool "HWMON support for Realtek PHYs"
	depends on HWMON && !(REALTEK_PHY=y && HWMON=m)
	help
	  Optional hwmon support for the temperature sensor

config RTL_RGMII_SGMII_3809
	bool "P3809 RGMII/SGMII bridge"
	help
	  Enable P3809 RGMII/SGMII bridge with 1GB speed

endif # REALTEK_PHY
```
