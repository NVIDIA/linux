## Documentation/devicetree/bindings/iio/adc/ti,ads7142.yaml
```yaml
# SPDX-License-Identifier: (GPL-2.0 OR BSD-2-Clause)
%YAML 1.2
---
$id: http://devicetree.org/schemas/iio/adc/ti,ads7142.yaml#
$schema: http://devicetree.org/meta-schemas/core.yaml#

title: TI ADS7142 dual-channel I2C analog to digital converter

maintainers:
  - Howard Tang <howardt@nvidia.com>

description: |
  Datasheet at: https://www.ti.com/lit/ds/symlink/ads7142.pdf

properties:
  compatible:
    enum:
      - ti,ads7142

  reg:
    maxItems: 1

required:
  - compatible
  - reg

additionalProperties: false

examples:
  - |
    i2c {
        #address-cells = <1>;
        #size-cells = <0>;

        adc@36 {
            compatible = "ti,ads7142";
            reg = <0x36>;
        };
    };
...
```

## Documentation/devicetree/bindings/soc/aspeed/aspeed-espi-slave.txt
```
ASPEED eSPI Slave Controller

Required properties:
 - compatible: must be one of:
	- "aspeed,ast2500-espi-slave"
	- "aspeed,ast2600-espi-slave"

 - reg: physical base address of the controller and length of memory mapped
   region

 - interrupts: interrupt generated by the controller

Example:

    espi: espi@1e6ee000 {
        compatible = "aspeed,ast2500-espi-slave";
        reg = <0x1e6ee000 0x100>;
        interrupts = <23>;
        status = "disabled";
};
```

## Documentation/devicetree/bindings/soc/aspeed/aspeed-mctp.txt
```
* Aspeed AST2600 MCTP PCIe VDM Controller

Required properties:
- compatible		: must be "aspeed,ast2600-mctp"
- reg			: contains the address and size of the memory region
			  associated with the MCTP controller
- resets		: reset specifier for the syscon reset associated with
			  the MCTP controller
- interrupts-extended	: two interrupt cells; the first specifies the global
			  interrupt for MCTP controller and the second
			  specifies the PCIe reset or PERST interrupt
- aspeed,pcieh		: a phandle to the PCIe Host Controller node to be
			  used in conjunction with the PCIe reset or PERST
			  interrupt
Example:

mctp: mctp@1e6e8000 {
	compatible = "aspeed,ast2600-mctp";
	reg = <0x1e6e8000 0x1000>;
	interrupts-extended = <&gic GIC_SPI 26 IRQ_TYPE_LEVEL_HIGH>,
		      <&scu_ic0 ASPEED_AST2600_SCU_IC0_PCIE_PERST_LO_TO_HI>;
	resets = <&syscon ASPEED_RESET_DEV_MCTP>;
	aspeed,pcieh = <&pcieh>;
	status = "disabled";
};
```

## drivers/misc/quanta_cpld/Kconfig
```kconfig
# SPDX-License-Identifier: GPL-2.0-only
#
# Misc strange devices
#

config QUANTA_LEGOCG1_CPLD
	tristate "Quanta LegoCG1 CPLD support"
	depends on I2C
	help
	  Provides a support for custom CPLD. Supports fans, leds and reporting
	  the firmware version used on the CPLD
```

## drivers/misc/smc_cpld/Kconfig
```kconfig
# SPDX-License-Identifier: GPL-2.0-only
#
# Misc strange devices
#

config SMC_LEGOC2_CPLD
	tristate "Supermicro LegoC2 CPLD support"
	depends on I2C
	help
	  Provides a support for custom CPLD. Supports fans, leds and sensors
```
