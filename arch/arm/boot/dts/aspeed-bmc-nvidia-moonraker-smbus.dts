// SPDX-License-Identifier: GPL-2.0+
/dts-v1/;

#include "aspeed-bmc-nvidia-moonraker.dts"


/ {
	model = "AST2600 Moonraker SMBUS";
	compatible = "aspeed,ast2600";
};

//Glacier smbus
&i2c8 {
	multi-master;
	status = "okay";
};
